/include/ "system-conf.dtsi"
#include <dt-bindings/gpio/gpio.h>

/ {
	model = "Zynq Zybo Development Board";
	compatible = "digilent,zynq-zybo", "xlnx,zynq-7000";

	chosen {
		bootargs = "console=ttyPS0,115200 earlyprintk uio_pdrv_genirq.of_id=generic-uio root=/dev/mmcblk0p2 rw rootwait";
	};

	usb_phy0: usb_phy@0 {
		compatible = "ulpi-phy";
		#phy-cells = <0>;
		reg = <0xe0002000 0x1000>;
		view-port = <0x0170>;
		drv-vbus;
	};


};

&usb0 {
	usb-phy = <&usb_phy0>;
	dr_mode = "host";
};
